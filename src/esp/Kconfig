## src/esp/Kconfig
```kconfig
# Kconfig settings for ESP32 MCUs
if MACH_ESP32

config ESP32_SELECT
    bool
    default y
    select ESP32_BOARD_CONFIG
    select ESP32_BOARD_WROOM32
    select MACH_ESP32_D0WD
    select MACH_ESP32_RAW
    select HAVE_GPIO
    select SERIAL

config ESP32_BOARD_CONFIG
    bool

config ESP32_BOARD_WROOM32
    bool

config MACH_ESP32_RAW
    bool
    
    config MACH_ESP32_D0WD
        bool
        depends on MACH_ESP32_RAW

config BOARD_DIRECTORY
    string
    default "esp"
menu "Develop Environment Setup"
config ESP32_COM_PORT
    prompt "COM Port For Flashing ESP32"
    string 
    default "ttyUSB0"
######################################################################
# SDK Path
######################################################################
config PATH_TO_ESP32_IDF
    prompt "Path to esp-idf sdk installation"
    string 
    default "$HOME/ESP32/esp-idf"
endmenu
######################################################################
# Chip selection
######################################################################

choice
    prompt "Chip/Modular Model(Currently Only Adds Support for ESP32-WROOM32E)"

    config MACH_ESP32_WROOM32E
        bool "ESP32_WROOM32E"
endchoice
menu "Hardware Configuration"
######################################################################
# Timer Clock selection
######################################################################
config CLOCK_FREQ
    int "System Timer Clock Frequency"
    default 1000000

######################################################################
# Serial Port selection
######################################################################
menuconfig ESP32_SERIAL_PORT
    bool "Enable ESP32 Klipper Serial Port"
if ESP32_SERIAL_PORT
choice
    prompt "Klipper Serial port selection"

    config KLIPPER_SERIAL_U0
        bool "UART0"
    config KLIPPER_SERIAL_U1
        bool "UART1"
    config KLIPPER_SERIAL_U2
        bool "UART2"
endchoice

config KLIPPER_SERIAL_TXD_PIN
    int "Klipper Serial TXD pin number"
    default 1
    range 0 40
    
config KLIPPER_SERIAL_RXD_PIN
    int "Klipper Serial RXD pin number"
    default 21 
    range 0 40
endif 

######################################################################
# IO Expansion selection
######################################################################

menuconfig ESP32_IO_EXPANSION
    bool "Use 74HC595s as output IO expansion"
if ESP32_IO_EXPANSION

choice
    prompt "Peripheral to Emulate IO expansion function"

    config ESP32_EXP_IO_SPI
        bool "SPI ()"
        help "Using hardware SPI to control 74HC595s IO Expansion, can do maximum 64 pin per chain @ 26MHz/64 refresh rate,can expand more pin through a second cs pin configuration"
        select ESP_HSPI

    config ESP32_EXP_IO_I2S
        bool "I2S"
        help "Using hardware I2S to control 74HC595s IO Expansion, can do maximum 32 pin at most ,@ 40Mhz/64 refresh rate"
        select ESP_I2S1
endchoice

config ESP32_EXP_IO_DATA_PIN 
    int "Output DATA pin"
    default 2
    range 0 40
config ESP32_EXP_IO_RCLK_PIN
    int "Output RCLK pin"
    default 3
    range 0 40
config ESP32_EXP_IO_SCLK_PIN
    int "Output SCLK pin"
    default 4
    range 0 40

config ESP32_EXP_IO_COUNT
    int 
    prompt "Pins to expand"
    default 32
    range 0 32 if ESP32_EXP_IO_I2S
    range 0 64 if ESP32_EXP_IO_SPI

config ESP32_IO_DUAL_EXPANSION
    bool "Enable Sencond IO expansion port"
    depends on ESP32_EXP_IO_SPI

config ESP32_EXP2_IO_SCLK_PIN
    int "Output SCLK pin for second expansion unit"
    depends on ESP32_IO_DUAL_EXPANSION
    default 32
config ESP32_EXP2_IO_COUNT
    int "Pins to expand for second expansion unit" 
    depends on ESP32_IO_DUAL_EXPANSION
    default 32
endif

menuconfig ESP32_SPI_ENABLE
    bool "Enable Hardware SPI"
    depends on !( ESP_HSPI )
    select HAVE_GPIO_SPI
if ESP32_SPI_ENABLE

if ! ESP_HSPI
config ESP_SPI_HSPI
    bool "Enable HSPI"
if ESP_SPI_HSPI
# config ESP_HSPI_CS
#     int "HSPI CS Pin"
#     range 0 40
config ESP_HSPI_CLK
    int "HSPI CLK Pin"
    range 0 40
config ESP_HSPI_MOSI
    int "HSPI MOSI Pin"
    range 0 40
config ESP_HSPI_MISO
    int "HSPI MISO Pin"
    range 0 40
endif
endif
if ! ESP_VSPI
config ESP_SPI_VSPI
    bool "Enable VSPI(if HSPI also enabled this is spi2)"
if ESP_SPI_VSPI
# config ESP_VSPI_CS
#     int "VSPI CS Pin"
#     range 0 40
config ESP_VSPI_CLK
    int "VSPI CLK Pin"
    range 0 40
config ESP_VSPI_MOSI
    int "VSPI MOSI Pin"
    range 0 40
config ESP_VSPI_MISO
    int "VSPI MISO Pin"
    range 0 40
endif
endif 
endif

endmenu
if MACH_ESP32_D0WD
    # SPI
    config ESP_HSPI
        bool
    config ESP_VSPI
        bool
    # I2S
    config ESP_I2S1
        bool
    config ESP_I2S2
        bool
endif



endif 
```
